## boards/aerorx/aerorx_r1/Kconfig.aerorx_r1_uf2
```kconfig
# Copyright (c) 2024 Nordic Semiconductor ASA
# SPDX-License-Identifier: Apache-2.0

config BOARD_AERORX_R1_UF2
	select SOC_NRF52840_QIAA
```

## boards/aerorx/aerorx_r1/board.yml
```yaml
# Copyright (c) 2024 Nordic Semiconductor ASA
# SPDX-License-Identifier: Apache-2.0

board:
  name: aerorx_r1_uf2
  vendor: aerorx
  socs:
    - name: nrf52840
```
